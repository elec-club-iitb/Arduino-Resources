/*
TV_Remote_IRrecvdemo_demo_with_LCD
    
    This is a simple Home automation type of project where a TV remote can be used to control intensity of lamps or speed of fans.
    Here we simulate the appliances by three lEDs - RGB and the intensity control is done by using PWM to control current through
    each LED. You can extend this program to include some On/Off type loads as well as use AC power Module Control to drive 
    actual 230V Ac appliances.
    
    This sketch uses a TSOP 1738 receiver and the code generated by it is used to control 3 independent variables 
    such as current through Red, Green and Blue LEDs. So the  Channel + and Channel - keys are used to select the variable.
    Once the parameter is selected then Volume+ and Volume- keys are used to increment or decrement the value by about 10%.
    Maximum being 255, each key pressing will either add 25 to it or subtract 25 from current intensity value. Thus the intensity 
    of that coloured LED changes accordingly.
    
    Note that the 3 LEDs are in the same package so if more than one current is active then all currents will cause individual
    colour component and net result will some intermediate shade. Best way to see the intensity change is to ensure that only 
    one LED has non-zero current.
    
    LCD is added to tell us the value of parameter and its values.Note that LCD pins used as 13,12,5,4,3,2 so that 3 PWM pins 
    at 9,10,11 can be used for LEDs.
    
 * IRremote: IRrecvDemo - demonstrates receiving IR codes with IRrecv
 * An IR detector/demodulator must be connected to the input RECV_PIN.
 * Version 0.1 July, 2009
 * Copyright 2009 Ken Shirriff
 * http://arcfn.com
 
 Modified by P W Dandekar on 5th October 2011.
 LCd added by P W dandekar in October 2015.
 
 */

#include <IRremote.h>
// include the library code:
#include <LiquidCrystal.h>



#define redPin   9   // Blue LED is fed by PWM on pin 13 (PD5)
#define greenPin 10    // Green LED is fed by PWM on pin 14 (Pb4)
#define bluePin  11    // Blue LED is fed by PWM on pin 12 (PD4)

// initialize the library with the numbers of the interface pins
LiquidCrystal lcd(13, 12, 5, 4, 3, 2);

int RECV_PIN = 8; // 

int b_intnsty, r_intnsty,g_intnsty; // define 3 variable for intensity of LED to be used in PWM value.
int led_index; // used as a pointer to select one particular LED at a time. It will have value 0 = None, 1= Blue; 2 = red and 3 = Green.


const unsigned long P_up = 0x20; 
const unsigned long P_down = 0x21; 
const unsigned long volume_down = 0x10; 
const unsigned long volume_up = 0x11; 
const unsigned long menu = 0x3B; 
const unsigned long jump = 948321258; 
const unsigned long zoom = 948321222; 
const unsigned long AV = 0x38; 
const unsigned long PP = 0x0E; 
const unsigned long disp = 0x0F; 

unsigned long l;
IRrecv irrecv(RECV_PIN);

decode_results results;

void disp_all(void)
{
  lcd.clear(); // clear previous data on both lines.  
  lcd.setCursor(0, 0);// set cursor to top row col 0.
  lcd.print("led_index");// show label
  lcd.setCursor(11, 0);// set cursor to top row col 11.
  lcd.print(led_index);// show value of label.
  lcd.setCursor(0, 1);// set cursor to second row col 0.
  lcd.print(b_intnsty);// show value of blue intensity.
  lcd.setCursor(5, 1);// set cursor to second row col 5.
  lcd.print(r_intnsty);// show value of red intensity.
  lcd.setCursor(10, 1);// set cursor to second row col 10.
  lcd.print(g_intnsty);// show value of green intensity.
  
}


void write_all_PWM(void)
{
   analogWrite( bluePin, b_intnsty);// write value of blue intensity on bluepin.
   analogWrite( redPin, r_intnsty);// write value of red intensity on bluepin.
   analogWrite( greenPin, g_intnsty);// write value of blue intensity on bluepin.
   
}// end of function write_all_PWM
  
void setup()
{
  // set up the LCD's number of columns and rows: 
  lcd.begin(16, 2);
  // Print a message to the LCD.
  lcd.print("TV Remote Demo..");
  // set the cursor to column 0, line 1
  // (note: line 1 is the second row, since counting begins with 0):
  lcd.setCursor(0, 1);
  // print the number of seconds since reset:
  lcd.print(millis()/1000);
  
  // initialize serial port.
  Serial.begin(9600);
  Serial.println("TV Remote Demo starts! ");
  
  irrecv.enableIRIn(); // Start the receiver
  r_intnsty = g_intnsty = b_intnsty = 255;// make all LEDs off initially. 
  write_all_PWM(); // This function sets all 3 PWM variables on three pins.
  Serial.println("Check all 3 LEDs ON!");  
  delay(1000);// keep all 3 LEDs ON for 1 second as testing of hardware.
  r_intnsty = g_intnsty = b_intnsty = 0;// make all LEDs off initially. 
  write_all_PWM(); // This function sets all 3 PWM variables on three pins.
  Serial.println("Check all 3 LEDs OFF!");  

  led_index =0;// none of the LEDs is selected.
  
}// end of setup.


void loop() {
  if (irrecv.decode(&results)) {
    l = results.value;// read code received for key pressed.
    if (l>0x7FF) {l = l - 0x800;}// subtract base value of 0x800 to normalize code received
    Serial.println(l,HEX);// print actual code     
 
    if (l == menu)            {    Serial.println("MENU Pressed");}
    if (l == jump)            {    Serial.println("JUMP Pressed");}
    if (l == zoom)            {    Serial.println("ZOOM Pressed");}
    if (l == AV )             {    Serial.println("AV Pressed");}
    if (l == PP )             {    Serial.println("PP Pressed");}
    if (l == disp)            {    Serial.println("DISP Pressed, all LEDs OFF! ");
    
    if (  (l >=0 ) && (l <=9 ) )
    {
      Serial.print("Digit key Pressed =   ");
      Serial.println(l);// print actual code     
    }
    
      //r_intnsty = g_intnsty = b_intnsty = 0;// make all LEDs off.
    }
    
    if (l == P_up)
    {
      Serial.println("P+ Pressed, increment LED number");
      led_index++; // select next LED.
      if (led_index >3) {led_index=3;}// do not allow LED number to go above 3.      
      Serial.print("New index value = ");
      Serial.println(led_index);
    }// processing of P+ command done.
    

    if (l == P_down)
    {
      Serial.println("P- Pressed, decrement LED number");
      led_index--; // select next LED.
      if (led_index <0) {led_index=0;}// do not allow LED number to go below 0.      
      Serial.print("New index value = ");
      Serial.println(led_index);
    }// processing of P- command done.
   
    if (l == volume_up) 
    { 
      Serial.println("volume_Up Pressed");

      //---------------------------------------------------------------------------
      if(led_index ==1)
      {
        b_intnsty = b_intnsty + 25;// increment PWM value by 10%. 
        if (b_intnsty > 255) 
        {
          b_intnsty = 255;
        }// do not let it overflow 255.        
        write_all_PWM(); // This function sets all 3 PWM variables on three pins.
        /*
        Serial.print("Blue intensity = ");
        Serial.println(b_intnsty);// show latest value.   
        Serial.print("DEBUG MESSAGE");
        */
        
      }// end of index = 1
    
      //---------------------------------------------------------------------------
      if(led_index ==2)
      {
        r_intnsty = r_intnsty + 25;// increment PWM value by 10%. 
        if (r_intnsty >255) {r_intnsty = 255;}// do not let it overflow 255.
        write_all_PWM(); // This function sets all 3 PWM variables on three pins.
        Serial.print("RED intensity = ");
        Serial.println(r_intnsty);// show latest value.          
        
      }// end of index = 2
      //---------------------------------------------------------------------------
      if(led_index ==3)
      {
        g_intnsty = g_intnsty + 25;// increment PWM value by 10%. 
        if (g_intnsty >255) {g_intnsty = 255;}// do not let it overflow 255.
        write_all_PWM(); // This function sets all 3 PWM variables on three pins.
        Serial.print("GREEN intensity = ");
        Serial.println(g_intnsty);// show latest value.          
        
      }// end of index = 3
      
    }// processing of Volume Up  command done.
  
    if (l == volume_down) 
    { 
      Serial.println("volume_Down Pressed");
      //---------------------------------------------------------------------------
      if(led_index ==1)
      {
        b_intnsty = b_intnsty - 25;// decrement PWM value by 10%. 
        if (b_intnsty <0) {b_intnsty = 0;}// do not let it underflow below 0.
        write_all_PWM(); // This function sets all 3 PWM variables on three pins.
        Serial.print("Blue intensity = ");
        Serial.println(b_intnsty);// show latest value.      
      }// end of index = 1
    
      //---------------------------------------------------------------------------
      if(led_index ==2)
      {
        r_intnsty = r_intnsty - 25;// decrement PWM value by 10%. 
        if (r_intnsty <0) {r_intnsty = 0;}// do not let it underflow below 0.
        write_all_PWM(); // This function sets all 3 PWM variables on three pins.
        Serial.print("RED intensity = ");
        Serial.println(r_intnsty);// show latest value.          
        
      }// end of index = 2
      //---------------------------------------------------------------------------
      if(led_index ==3)
      {
        g_intnsty = g_intnsty - 25;// decrement PWM value by 10%. 
        if (g_intnsty <0) {g_intnsty = 0;}// do not let it underflow below 0.
        write_all_PWM(); // This function sets all 3 PWM variables on three pins.
        Serial.print("GREEN intensity = ");
        Serial.println(g_intnsty);// show latest value.          
        
      }// end of index = 3
      
     }// processing of Volume Down  command done.   
     
     delay(1000);// put 1 second delay so that multiple code for one key depression all are discarded.
     irrecv.resume(); // Receive the next value
     write_all_PWM(); // This function sets all 3 PWM variables on three pins.
     disp_all();// update results on LCD

   }// end of if for irrecv.decode(&results)
    
  
}// end of loop

    
    
/*    
    if (l == menu)            {    Serial.println("MENU Pressed");}
    if (l == jump)            {    Serial.println("JUMP Pressed");}
    if (l == zoom)            {    Serial.println("ZOOM Pressed");}
    if (l == tv_av )          {    Serial.println("TV/AV Pressed");}
    if (l == p_dot_p )        {    Serial.println("P.P Pressed");}
*/

